## boards/dfrobot/firebeetle2_esp32c6/Kconfig
```kconfig
# Copyright (c) 2024 DFRobot
# SPDX-License-Identifier: Apache-2.0

config HEAP_MEM_POOL_ADD_SIZE_BOARD
	int
	default 4096 if BOARD_FIREBEETLE2_ESP32C6_ESP32C6_HPCORE
```

## boards/dfrobot/firebeetle2_esp32c6/Kconfig.board
```kconfig
# DFRobot FireBeetle 2 ESP32-C6 board configuration options

# Copyright (c) 2024 DFRobot
# SPDX-License-Identifier: Apache-2.0

config BOARD_FIREBEETLE2_ESP32C6
	select SOC_ESP32C6
```

## boards/dfrobot/firebeetle2_esp32c6/Kconfig.defconfig
```kconfig
# DFRobot FireBeetle 2 ESP32-C6 board default configuration

# Copyright (c) 2024 DFRobot  
# SPDX-License-Identifier: Apache-2.0

if BOARD_FIREBEETLE2_ESP32C6

config BOARD
	default "firebeetle2_esp32c6"

endif # BOARD_FIREBEETLE2_ESP32C6
```

## boards/dfrobot/firebeetle2_esp32c6/Kconfig.firebeetle2_esp32c6
```kconfig
# DFRobot FireBeetle 2 ESP32-C6 board configuration

# Copyright (c) 2024 DFRobot
# SPDX-License-Identifier: Apache-2.0

config BOARD_FIREBEETLE2_ESP32C6
	select SOC_ESP32_C6_WROOM_1U_N8
	select SOC_ESP32C6_HPCORE if BOARD_FIREBEETLE2_ESP32C6_ESP32C6_HPCORE
```

## boards/dfrobot/firebeetle2_esp32c6/board.yml
```yaml
board:
  name: firebeetle2_esp32c6
  full_name: DFRobot FireBeetle 2 ESP32-C6
  vendor: dfrobot
  socs:
  - name: esp32c6
```

## boards/dfrobot/firebeetle2_esp32c6/firebeetle2_esp32c6_defconfig
```kconfig
# DFRobot FireBeetle 2 ESP32-C6 board configuration

# Basic ESP32-C6 configuration
CONFIG_SOC_SERIES_ESP32C6=y
CONFIG_SOC_ESP32C6=y
CONFIG_BOARD_FIREBEETLE2_ESP32C6=y

# Enable console and GPIO
CONFIG_CONSOLE=y
CONFIG_SERIAL=y
CONFIG_GPIO=y

# Enable GPIO interrupt for buttons
CONFIG_GPIO_ESP32=y

# Flash and memory configuration  
CONFIG_FLASH_SIZE=4096
CONFIG_FLASH_BASE_ADDRESS=0x0

# Enable bootloader
CONFIG_BOOTLOADER_ESP_IDF=y

# Enable USB CDC for debugging (optional)
CONFIG_ESP_CONSOLE_USB_CDC=y
```
